## conf/layer.conf
```bitbake
# We have a conf and classes directory, add to BBPATH
BBPATH .= ":${LAYERDIR}"

# We have recipes-* directories, add to BBFILES
BBFILES += "${LAYERDIR}/recipes-*/*/*/*.bb \
            ${LAYERDIR}/recipes-*/*/*/*.bbappend"

BBFILE_COLLECTIONS += "meta-libvirt"
BBFILE_PATTERN_meta-libvirt = "^${LAYERDIR}/"
BBFILE_PRIORITY_meta-libvirt = "6"

LAYERDEPENDS_meta-libvirt = "core"
LAYERSERIES_COMPAT_meta-libvirt = "gatesgarth"
```
